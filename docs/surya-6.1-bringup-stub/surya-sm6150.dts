// SPDX-License-Identifier: GPL-2.0-only
/*
 * Surya (POCO X3 NFC / J20C, sm6150/sdmmagpie) - initial 6.1 bring-up stub.
 *
 * Ported/audited from msm-4.14 tree:
 *   - arch/arm64/boot/dts/qcom/sdmmagpie-idp-overlay-miui.dts
 *   - arch/arm64/boot/dts/qcom/haptic.dtsi
 *   - arch/arm64/boot/dts/qcom/touchscreen.dtsi
 *   - arch/arm64/boot/dts/qcom/sdmmagpie.dtsi (memory reference only)
 *
 * STATUS: STUB - NOT BOOTABLE. Memory map, panel/touch/haptics/audio/modem
 * nodes are placeholders/TODOs and must be validated on device.
 */
/dts-v1/;

#include <dt-bindings/input/linux-event-codes.h>
#include "sm6150.dtsi"

/ {
	model = "Xiaomi POCO X3 NFC";
	compatible = "xiaomi,surya", "qcom,sm6150";
	/* Values from 4.14 sdmmagpie-idp-overlay-miui.dts */
	qcom,msm-id = <365 0x0>;
	qcom,board-id = <34 0>;
};

/*
 * TODO(surya): Validate memory map against surya firmware/ABL and 6.1 sm6150.dtsi.
 * Do NOT blindly copy these addresses. 4.14 sdmmagpie.dtsi reference:
 *   hyp_region         0x85700000 0x600000
 *   xbl_aop_mem        0x85e00000 0x1ff000
 *   sec_apps_mem       0x85fff000 0x1000
 *   smem_region        0x86000000 0x200000
 *   removed_region     0x86200000 0x2d00000
 *   pil_camera_mem     0x8ab00000 0x500000
 *   pil_modem_mem      0x8b000000 0x8400000
 *   pil_video_mem      0x93400000 0x500000
 *   ramoops_mem        0x9d800000 0x400000 (record 0x80000, pmsg 0x200000, console 0x100000)
 *
 * Also check violet-sm6150.dts overrides for the pattern used in this 6.1 tree.
 */

/* Secure-world GPIOs; keep reserved ranges as on other sm6150 devices. */
&tlmm {
	gpio-reserved-ranges = <0 4>;
};

/*
 * TODO(surya): ADSP/PIL - confirm firmware paths and late-boot policy.
 * 4.14 had qcom,adsp on pil/remoteproc; 6.1 uses qcom_q6v5_pas style.
 */

/*
 * TODO(surya): Display - NT36672C Huaxing/Tianma FHD video panels.
 * 4.14 overlay marked:
 *   dsi_nt36672c_huaxing_fhd_video_display { qcom,dsi-display-active; };
 *   dsi_nt36672c_tianma_fhd_video_display  { qcom,dsi-display-active; };
 * Port to 6.1 DRM/MSM DSI panel bindings.
 */

/*
 * TODO(surya): Touchscreen - Novatek NT36xxx SPI (novatek,NVT-ts-spi).
 * 4.14: qupv3_se0_spi, reg 0, spi-max-frequency 19200000,
 *       reset-gpio = <&tlmm 8 0x00>, irq-gpio = <&tlmm 9 0x2001>,
 *       vddio L18A, lab lcdb_ldo_vreg, ibb lcdb_ncp_vreg.
 * Driver: drivers/input/touchscreen/nt36xxx_spi/ (needs 6.1 API port).
 */

/*
 * TODO(surya): Haptics - AW8624/DRV2624 on qupv3_se1_i2c @0x5A.
 * 4.14: compatible "awinic,aw8624_haptic","ti,drv2624",
 *       reset-gpio tlmm 63, irq-gpio tlmm 26.
 * Drivers: drivers/misc/aw8624_haptic/, drivers/misc/drv2624_haptic/.
 */

/*
 * TODO(surya): Battery auth - xiaomi,onewire_gpio (gpio6) + maxim,ds28e16.
 * Drivers: drivers/power/supply/maxim/onewire_gpio.c, ds28e16.c.
 */

/*
 * TODO(surya): Audio - port sm6150/sdmmagpie audio overlay patterns for surya.
 * TODO(surya): Camera, NFC, sensors, IR SPI (qupv3_se11_spi), USB, charger/fuel gauge.
 */
